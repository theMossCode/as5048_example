## prj.conf
```kconfig
# Copyright (c) 2021 Nordic Semiconductor ASA
# SPDX-License-Identifier: Apache-2.0
#
# This file contains selected Kconfig options for the application.

CONFIG_SPI=y
CONFIG_NRF_SPI=y
CONFIG_AS5048A=y
```

## src/main.c
```c
/*
 * Copyright (c) 2021 Nordic Semiconductor ASA
 * SPDX-License-Identifier: Apache-2.0
 */

#include <zephyr.h>
#include "../../drivers/as5048a/as5048a.h"

void main(void)
{
	int ret;
	const struct device *sensor;

	printk("Zephyr Example Application");

	// sensor = DEVICE_DT_GET(DT_NODELABEL(examplesensor0));
	// if (!device_is_ready(sensor)) {
	// 	LOG_ERR("Sensor not ready");
	// 	return;
	// }

	while (1) {
		// struct sensor_value val;

		// ret = sensor_sample_fetch(sensor);
		// if (ret < 0) {
		// 	LOG_ERR("Could not fetch sample (%d)", ret);
		// 	return;
		// }

		// ret = sensor_channel_get(sensor, SENSOR_CHAN_PROX, &val);
		// if (ret < 0) {
		// 	LOG_ERR("Could not get sample (%d)", ret);
		// 	return;
		// }

		// printk("Sensor value: %d\n", val.val1);

		// k_sleep(K_MSEC(1000));
	}
}
```
